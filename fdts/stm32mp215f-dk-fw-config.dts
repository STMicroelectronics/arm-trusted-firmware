// SPDX-License-Identifier: (GPL-2.0-only OR BSD-3-Clause)
/*
 * Copyright (C) 2024, STMicroelectronics - All Rights Reserved
 */

#include "stm32mp21-fw-config.dtsi"
#include "stm32mp215f-dk-ca35tdcid-fw-config.dtsi"