## docs/devicetree/bindings/clock/st,stm32mp1-rcc.txt
```
STMicroelectronics STM32 Peripheral Reset Clock Controller
==========================================================

The RCC IP is both a reset and a clock controller.

RCC makes also power management (resume/supend and wakeup interrupt).

Please also refer to reset.txt for common reset controller binding usage.

Please also refer to clock-bindings.txt for common clock controller
binding usage.


Required properties:
- compatible: "st,stm32mp1-rcc-secure", "st,stm32mp1-rcc", "syscon"
  Adding "st,stm32mp1-rcc-secure" in the compatible list restricts
  RCC access through RCC TZ_ENABLE bit.
- reg: should be register base and length as documented in the datasheet
- #clock-cells: 1, device nodes should specify the clock in their
  "clocks" property, containing a phandle to the clock device node,
  an index specifying the clock to use.
- #reset-cells: Shall be 1
- interrupts: Should contain a general interrupt line.
- secure-interrupts: Should contain a interrupt line to the wake-up of
                     processor (CSTOP).

Example:
	rcc: rcc@50000000 {
		compatible = "st,stm32mp1-rcc", "syscon";
		reg = <0x50000000 0x1000>;
		#clock-cells = <1>;
		#reset-cells = <1>;
		interrupts = <GIC_SPI 5 IRQ_TYPE_LEVEL_HIGH>;
		secure-interrupts = <GIC_SPI 145 IRQ_TYPE_LEVEL_HIGH>;
	};

Specifying clocks
=================

All available clocks are defined as preprocessor macros in
dt-bindings/clock/stm32mp1-clks.h header and can be used in device
tree sources.

Specifying softreset control of devices
=======================================

Device nodes should specify the reset channel required in their "resets"
property, containing a phandle to the reset device node and an index specifying
which channel to use.
The index is the bit number within the RCC registers bank, starting from RCC
base address.
It is calculated as: index = register_offset / 4 * 32 + bit_offset.
Where bit_offset is the bit offset within the register.

For example on STM32MP1, for LTDC reset:
 ltdc = APB4_RSTSETR_offset / 4 * 32 + LTDC_bit_offset
      = 0x180 / 4 * 32 + 0 = 3072

The list of valid indices for STM32MP1 is available in:
include/dt-bindings/reset-controller/stm32mp1-resets.h

This file implements defines like:
#define LTDC_R	3072


Defining clock source distribution with property st,clksrc
==========================================================

- st,clksrc : used to configure the peripherals kernel clock selection.

  The property is a list of peripheral kernel clock source identifiers defined
  by macros CLK_<KERNEL-CLOCK>_<PARENT-CLOCK> as defined by header file
  dt-bindings/clock/stm32mp13-clksrc.h.

  st,clksrc may not list all the kernel clocks and has no ordering requirements.

  Property can be used to configure the clock distribution tree.

  Example:
	st,clksrc = <
		CLK_MPU_PLL1P
		CLK_AXI_PLL2P
		CLK_MCU_PLL3P
		CLK_CKPER_HSE
		CLK_FMC_ACLK
		CLK_QSPI_ACLK
		CLK_ETH_DISABLED
		CLK_SDMMC12_PLL4P
	>;

Defining clock dividers with property st,clkdiv
===============================================

- st,clkdiv : The property is a list of dividers defined
              by macros DIV(DIV_<DIV-CLOCK>, value) as defined by header file
	      dt-bindings/clock/stm32mp15-clksrc.h.

  Property can be used to configure the clock main dividers value.

  For the STM32MP15x family there are 11 dividers values expected.
		MPU AXI MCU APB1 APB2 APB3 APB4 APB5 RTC MCO1 MCO2

  Each divider value uses the DIV coding defined in RCC associated
  register RCC_xxxDIVR. In most cases, it is:
		0x0: not divided
		0x1: division by 2
		0x2: division by 4
		0x3: division by 8
		...

  Note that the coding is different for:

  DIV_RTC DIV_MCO1 DIV_MCO2
		0x0: not divided
		0x1: division by 2
		0x2: division by 3
		0x3: division by 4
		...

  DIV_MPU
		0x0: no clock generated
		0x1: division by 2
		0x2: division by 3
		0x3: division by 4
		...
		0xf: division by 16

  Example:
	st,clkdiv = <
		DIV(DIV_MPU, 1)
		DIV(DIV_AXI, 0)
		DIV(DIV_MCU, 0)
		DIV(DIV_APB1, 1)
		DIV(DIV_APB2, 1)
		DIV(DIV_APB3, 1)
		DIV(DIV_APB4, 1)
		DIV(DIV_APB5, 2)
		DIV(DIV_RTC, 23)
		DIV(DIV_MCO1, 0)
		DIV(DIV_MCO2, 0)
	>;

Defining peripheral PLL frequencies
========================================================

- children for a PLL static configuration with "st,stm32mp1-pll" compatible

  Each PLL children node for PLL1 to PLL4 (see ref manual for details)
  are listed with associated reg 0 to 3.

  PLL2, PLL3 or PLL4 are off when their associated nodes are absent or
  deactivated.

  The configuration of PLL1, the source clock of Cortex-A7 core, with st,pll@0
  node, is optional as TF-A automatically selects the most suitable operating
  point for the platform.
  The node st,pll@0 node should be absent; it is only used if you want to
  override the PLL1 properties computed by TF-A (clock spreading for example).

      Here are the available properties for each PLL node:
    - compatible: should be "st,stm32mp1-pll"

    - reg: index of the pll instance

    - st,pll: Phandle of the default PLL configuration.
              A PLL can have several configuration (5 max) and should be described in a subnode
              just below.

    - pllx_cfgx node: The PLL configuration node is composed of 2 mandatory parameters:
        - st,pll_vco: Phandle of PLL VCO configuration.
	              See description of 'st,pll_vco' node.

        - st,pll_div_pqr: The parameters for PLL configuration in the following order:
                          DIVP DIVQ DIVR Output.

			  DIVx values are defined as in RCC spec:
			  0x0: bypass (division by 1)
			  0x1: division by 2
			  0x2: division by 3
			  0x3: division by 4
			  ...
  Note that in the next stage (e.g. OP-TEE) the phandle of the default PLL configuration
  ('st,pll') is optional (the configuration of TF-A will be kept).

- st,pll_vco node: This node will contain all VCO configuration of all PLLs in subnodes.
                   We will find theses parameters in each subnode.

	   -src: Clock source configuration values are defined by macros CLK_<NAME>_<SOURCE>
                 from dt-bindings/clock/stm32mp13-clksrc.h.

	   -divmn: The parameters for PLL divider (DIVM) and multiplication factor (DIVN)
	           configuration.

	   - frac: Fractional part of the multiplication factor
                   (optional, PLL is in integer mode when absent).

	   - csg: Clock Spreading Generator (optional) with parameters in the
	          following order: MOD_PER INC_STEP SSCG_MODE.

	          MOD_PER: Modulation Period Adjustment
		  INC_STEP: Modulation Depth Adjustment
		  SSCG_MODE: Spread spectrum clock generator mode, with associated
			     defined from stm32mp13-clksrc.h:
		               - SSCG_MODE_CENTER_SPREAD = 0
			       - SSCG_MODE_DOWN_SPREAD = 1

    Example:
	st,pll_vco {
		pll1_vco_1300Mhz: pll1-vco-1300Mhz {
			src = <CLK_PLL12_HSE>;
			divmn = <2 80>;
			frac = <0x800>;
		};
		...
		pll2_vco_1066Mhz: pll2-vco-1066Mhz {
			src = <CLK_PLL12_HSE>;
			divmn = <2 65>;
			frac = <0x1400>;
			csg = <10 20 1>;
		};
		...
	};

	pll1: st,pll@0 {
		compatible = "st,stm32mp1-pll";
		reg = <0>;

		st,pll = <&pll1_cfg1>;

		pll1_cfg1: pll1_cfg1 {
			st,pll_vco = <&pll1_vco_1300Mhz>;
			st,pll_div_pqr = <0 0 0>;
		};
	};

	st,pll@1 {
		compatible = "st,stm32mp1-pll";
		reg = <1>;

		st,pll = <&pll2_cfg1>;

		pll2_cfg1: pll2_cfg1 {
			st,pll_vco = <&pll2_vco_1066Mhz>;
			st,pll_div_pqr = <1 0 1>;
		};
	};

  Note: PLL1 and PLL2 have same source clock, if source clock is different
  between PLL1 and PLL2 a panic will be generated.

Fixed clocks description
========================

The clock tree is also based on 5 fixed-clock in clocks node
used to define the state of associated ST32MP1 oscillators:
  - clk-lsi
  - clk-lse
  - clk-hsi
  - clk-hse
  - clk-csi

At boot the clock tree initialization will
  - enable oscillators present in device tree and not disabled
    (node with status="disabled"),
  - disable HSI oscillator if the node is absent (always activated by bootrom)
    or disabled (node with status="disabled").

Optional properties :

a) for external oscillator: "clk-lse", "clk-hse"

  4 optional fields are managed
  - "st,bypass" configures the oscillator bypass mode (HSEBYP, LSEBYP)
  - "st,digbypass" configures the bypass mode as full-swing digital
    signal (DIGBYP)
  - "st,css" activates the clock security system (HSECSSON, LSECSSON)
  - "st,drive" (only for LSE) contains the value of the drive for the
     oscillator (see LSEDRV_ defined in the file
     dt-bindings/clock/stm32mp1-clksrc.h)

  Example board file:
	/ {
		clocks {
			clk_hse: clk-hse {
				#clock-cells = <0>;
				compatible = "fixed-clock";
				clock-frequency = <24000000>;
				st,bypass;
			};

			clk_lse: clk-lse {
				#clock-cells = <0>;
				compatible = "fixed-clock";
				clock-frequency = <32768>;
				st,css;
				st,drive = <LSEDRV_LOWEST>;
			};
	};

b) for internal oscillator: "clk-hsi"

  Internally HSI clock is fixed to 64MHz for STM32MP157 SoC.
  In device tree, clk-hsi is the clock after HSIDIV (clk_hsi in RCC
  doc). So this clock frequency is used to compute the expected HSI_DIV
  for the clock tree initialization.

  Example with HSIDIV = /1:
	/ {
		clocks {
			clk_hsi: clk-hsi {
				#clock-cells = <0>;
				compatible = "fixed-clock";
				clock-frequency = <64000000>;
			};
	};

  Example with HSIDIV = /2
	/ {
		clocks {
			clk_hsi: clk-hsi {
				#clock-cells = <0>;
				compatible = "fixed-clock";
				clock-frequency = <32000000>;
			};
	};

HSI & CSI calibration
========================

Calibration is an optional feature that may be enabled from device tree. It
allows to request calibration of the HSI or the CSI clocks from several means:
	- SiP SMC service
	- Periodic calibration every X seconds
	- Interrupt raised by the MCU

This feature requires that a HW timer is assigned to the calibration sequence.

Dedicated secure interrupt must be defined using "mcu_sev" name to start a
calibration on detection of an interrupt raised by MCU.

- st,hsi-cal: used to enable HSI clock calibration feature.

- st,csi-cal: used to enable CSI clock calibration feature.

- st,cal-sec: used to enable periodic calibration every specified seconds from
  secure monitor. Time must be given in seconds. If not specified, calibration
  is processed for each incoming request.

Example:
	&rcc {
		st,hsi-cal;
		st,csi-cal;
		st,cal-sec = <15>;
		secure-interrupts = <GIC_SPI 144 IRQ_TYPE_LEVEL_HIGH>,
				<GIC_SPI 145 IRQ_TYPE_LEVEL_HIGH>;
		secure-interrupt-names = "mcu_sev", "wakeup";
	};


Example of clock tree initialization
====================================

/ {
	clocks {
		clk_hse: clk-hse {
			#clock-cells = <0>;
			compatible = "fixed-clock";
			clock-frequency = <24000000>;
			st,digbypass;
		};

		clk_hsi: clk-hsi {
			#clock-cells = <0>;
			compatible = "fixed-clock";
			clock-frequency = <64000000>;
		};

		clk_lse: clk-lse {
			#clock-cells = <0>;
			compatible = "fixed-clock";
			clock-frequency = <32768>;
		};

		clk_lsi: clk-lsi {
			#clock-cells = <0>;
			compatible = "fixed-clock";
			clock-frequency = <32000>;
		};

		clk_csi: clk-csi {
			#clock-cells = <0>;
			compatible = "fixed-clock";
			clock-frequency = <4000000>;
		};
	};

	soc {

		rcc: rcc@50000000 {
			compatible = "st,stm32mp1-rcc", "syscon";
			reg = <0x50000000 0x1000>;
			#address-cells = <1>;
			#size-cells = <0>;
			#clock-cells = <1>;
			#reset-cells = <1>;
			interrupts = <GIC_SPI 5 IRQ_TYPE_LEVEL_HIGH>;
			secure-interrupts = <GIC_SPI 145 IRQ_TYPE_LEVEL_HIGH>;
			secure-interrupt-names = "wakeup";

	st,clksrc = <
		CLK_MPU_PLL1P
		CLK_AXI_PLL2P
		CLK_MCU_PLL3P
		CLK_RTC_LSE
		CLK_MCO1_DISABLED
		CLK_MCO2_DISABLED
		CLK_CKPER_HSE
		CLK_FMC_ACLK
		CLK_QSPI_ACLK
		CLK_ETH_PLL4P
		CLK_SDMMC12_PLL4P
		CLK_DSI_DSIPLL
		CLK_STGEN_HSE
		CLK_USBPHY_HSE
		CLK_SPI2S1_PLL3Q
		CLK_SPI2S23_PLL3Q
		CLK_SPI45_HSI
		CLK_SPI6_HSI
		CLK_I2C46_HSI
		CLK_SDMMC3_PLL4P
		CLK_USBO_USBPHY
		CLK_ADC_CKPER
		CLK_CEC_LSE
		CLK_I2C12_HSI
		CLK_I2C35_HSI
		CLK_UART1_HSI
		CLK_UART24_HSI
		CLK_UART35_HSI
		CLK_UART6_HSI
		CLK_UART78_HSI
		CLK_SPDIF_PLL4P
		CLK_FDCAN_PLL4R
		CLK_SAI1_PLL3Q
		CLK_SAI2_PLL3Q
		CLK_SAI3_PLL3Q
		CLK_SAI4_PLL3Q
		CLK_RNG1_CSI
		CLK_RNG2_LSI
		CLK_LPTIM1_PCLK1
		CLK_LPTIM23_PCLK3
		CLK_LPTIM45_LSE
	>;

	st,clkdiv = <
		DIV(DIV_MPU, 1)
		DIV(DIV_AXI, 0)
		DIV(DIV_MCU, 0)
		DIV(DIV_APB1, 1)
		DIV(DIV_APB2, 1)
		DIV(DIV_APB3, 1)
		DIV(DIV_APB4, 1)
		DIV(DIV_APB5, 2)
		DIV(DIV_RTC, 23)
		DIV(DIV_MCO1, 0)
		DIV(DIV_MCO2, 0)
	>;

	st,pll_vco {
		pll2_vco_1066Mhz: pll2-vco-1066Mhz {
			src = <CLK_PLL12_HSE>;
			divmn = <2 65>;
			frac = <0x1400>;
		};

		pll3_vco_417Mhz: pll2-vco-417_8Mhz {
			src = <CLK_PLL3_HSE>;
			divmn = <1 33>;
			frac = <0x1a04>;
		};

		pll4_vco_594Mhz: pll2-vco-594Mhz {
			src = <CLK_PLL4_HSE>;
			divmn = <3 98>;
		};
	};

	/* VCO = 1066.0 MHz => P = 266 (AXI), Q = 533 (GPU), R = 533 (DDR) */
	pll2: st,pll@1 {
		compatible = "st,stm32mp1-pll";
		reg = <1>;

		st,pll = <&pll2_cfg1>;

		pll2_cfg1: pll2_cfg1 {
			st,pll_vco = <&pll2_vco_1066Mhz>;
			st,pll_div_pqr = <1 0 0>;
		};
	};

	/* VCO = 417.8 MHz => P = 209, Q = 24, R = 11 */
	pll3: st,pll@2 {
		compatible = "st,stm32mp1-pll";
		reg = <2>;

		st,pll = <&pll3_cfg1>;

		pll3_cfg1: pll3_cfg1 {
			st,pll_vco = <&pll3_vco_417Mhz>;
			st,pll_div_pqr = <1 16 36>;
		};
	};

	/* VCO = 594.0 MHz => P = 99, Q = 74, R = 74 */
	pll4: st,pll@3 {
		compatible = "st,stm32mp1-pll";
		reg = <3>;

		st,pll = <&pll4_cfg1>;

		pll4_cfg1: pll4_cfg1 {
			st,pll_vco = <&pll4_vco_594Mhz>;
			st,pll_div_pqr = <5 7 7>;
		};
	};
};
```
