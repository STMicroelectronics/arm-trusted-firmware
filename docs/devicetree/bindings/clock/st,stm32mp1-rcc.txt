## docs/devicetree/bindings/i2c/i2c-stm32.txt
```
* I2C controller embedded in STMicroelectronics STM32 I2C platform

Required properties :
- compatible : Must be one of the following
  - "st,stm32f7-i2c"
- reg : Offset and length of the register set for the device
- resets: Must contain the phandle to the reset controller.
- clocks: Must contain the input clock of the I2C instance.
- A pinctrl state named "default" must be defined to set pins in mode of
  operation for I2C transfer. An optional pinctrl state named "sleep" has to
  be defined as well as to put I2C in low power mode in suspend mode.
- #address-cells = <1>;
- #size-cells = <0>;

Optional properties :
- clock-frequency : Desired I2C bus clock frequency in Hz. If not specified,
  the default 100 kHz frequency will be used.
- i2c-scl-rising-time-ns : Only for STM32F7, I2C SCL Rising time for the board
  (default: 25)
- i2c-scl-falling-time-ns : Only for STM32F7, I2C SCL Falling time for the board
  (default: 10)
  I2C Timings are derived from these 2 values
- st,syscfg-fmp:  Only for STM32F7, use to set Fast Mode Plus bit within SYSCFG
  whether Fast Mode Plus speed is selected by slave.
	1st cell : phandle to syscfg
	2nd cell : register offset within SYSCFG
	3rd cell : register bitmask for FMP bit

Example :

	i2c@40005400 {
		compatible = "st,stm32f4-i2c";
		#address-cells = <1>;
		#size-cells = <0>;
		reg = <0x40005400 0x400>;
		resets = <&rcc 277>;
		clocks = <&rcc 0 149>;
		pinctrl-0 = <&i2c1_sda_pin>, <&i2c1_scl_pin>;
		pinctrl-names = "default";
	};

	i2c@40005400 {
		compatible = "st,stm32f7-i2c";
		#address-cells = <1>;
		#size-cells = <0>;
		reg = <0x40005400 0x400>;
		resets = <&rcc STM32F7_APB1_RESET(I2C1)>;
		clocks = <&rcc 1 CLK_I2C1>;
		pinctrl-0 = <&i2c1_sda_pin>, <&i2c1_scl_pin>;
		pinctrl-1 =  <&i2c1_sda_pin_sleep>, <&i2c1_scl_pin_sleep>;
		pinctrl-names = "default", "sleep";
		st,syscfg-fmp = <&syscfg 0x4 0x1>;
	};
```

## docs/devicetree/bindings/memory-controllers/st,stm32mp2-ddr.txt
```
st,stm32mp2 DDR3/DDR4/LPDDR4 controller (DDRCTRL and DDRPHYC)

--------------------
Required properties:
--------------------
- compatible	: Should be "st,stm32mp2-ddr"
- reg		: controller (DDRCTRL) and phy (DDRPHYC) base address

And the supply attributes are depending on the DDR type (DDR3/DDR4/LPDDR4).

For DDR3:
- vdd-supply	: phandle to the VDD/VDDQ regulator device tree node.
- vref-supply	: phandle to the VREFCA/VREFDQ regulator device tree node.
- vtt-supply	: phandle to the VTT regulator device tree node.

For DDR4:
- vdd-supply	: phandle to the VDD/VDDQ regulator device tree node.
- vref-supply	: phandle to the VREFCA regulator device tree node.
- vpp-supply	: phandle to the VPP regulator device tree node.
- vtt-supply	: phandle to the VTT regulator device tree node.

For LPDDR4:
- vdd1-supply	: phandle to the VDD1 regulator device tree node.
- vdd2-supply	: phandle to the VDD2/VDDCA regulator device tree node.
- vddq-supply	: phandle to the VDDQ regulator device tree node.

the next attributes are DDR parameters, they are generated by DDR tools
included in STM32 Cube tool

info attributes:
----------------
- st,mem-name	: name for DDR configuration, simple string for information
- st,mem-speed	: DDR expected speed for the setting in kHz
- st,mem-size	: DDR mem size in byte


controller attributes:
----------------------
- st,ctl-reg	: controller values depending of the DDR type
		  (DDR3/DDR4/LPDDR4)
	48 values are requested in this order
		MSTR
		MRCTRL0
		MRCTRL1
		MRCTRL2
		DERATEEN
		DERATEINT
		DERATECTL
		PWRCTL
		PWRTMG
		HWLPCTL
		RFSHCTL0
		RFSHCTL1
		RFSHCTL3
		CRCPARCTL0
		CRCPARCTL1
		INIT0
		INIT1
		INIT2
		INIT3
		INIT4
		INIT5
		INIT6
		INIT7
		DIMMCTL
		RANKCTL
		RANKCTL1
		ZQCTL0
		ZQCTL1
		ZQCTL2
		DFITMG0
		DFITMG1
		DFILPCFG0
		DFILPCFG1
		DFIUPD0
		DFIUPD1
		DFIUPD2
		DFIMISC
		DFITMG2
		DFITMG3
		DBICTL
		DFIPHYMSTR
		DBG0
		DBG1
		DBGCMD
		SWCTL
		SWCTLSTATIC
		POISONCFG
		PCCFG

- st,ctl-timing	: controller values depending of frequency and timing parameter
		  of DDR
	 20 values are requested in this order
		RFSHTMG
		RFSHTMG1
		DRAMTMG0
		DRAMTMG1
		DRAMTMG2
		DRAMTMG3
		DRAMTMG4
		DRAMTMG5
		DRAMTMG6
		DRAMTMG7
		DRAMTMG8
		DRAMTMG9
		DRAMTMG10
		DRAMTMG11
		DRAMTMG12
		DRAMTMG13
		DRAMTMG14
		DRAMTMG15
		ODTCFG
		ODTMAP

- st,ctl-map	: controller values depending of address mapping
	12 values are requested in this order
		ADDRMAP0
		ADDRMAP1
		ADDRMAP2
		ADDRMAP3
		ADDRMAP4
		ADDRMAP5
		ADDRMAP6
		ADDRMAP7
		ADDRMAP8
		ADDRMAP9
		ADDRMAP10
		ADDRMAP11

- st,ctl-perf	: controller values depending of performance and scheduling
	21 values are requested in this order
		SCHED
		SCHED1
		PERFHPR1
		PERFLPR1
		PERFWR1
		SCHED3
		SCHED4
		PCFGR_0
		PCFGW_0
		PCTRL_0
		PCFGQOS0_0
		PCFGQOS1_0
		PCFGWQOS0_0
		PCFGWQOS1_0
		PCFGR_1
		PCFGW_1
		PCTRL_1
		PCFGQOS0_1
		PCFGQOS1_1
		PCFGWQOS0_1
		PCFGWQOS1_1

phyc attributes:
----------------
- st,phy-basic	: basic entry values for the PHYINIT driver
	19 values are requested in this order
		UIB_DRAMTYPE
		UIB_DIMMTYPE
		UIB_LP4XMODE
		UIB_NUMDBYTE
		UIB_NUMACTIVEDBYTEDFI0
		UIB_NUMACTIVEDBYTEDFI1
		UIB_NUMANIB
		UIB_NUMRANK_DFI0
		UIB_NUMRANK_DFI1
		UIB_DRAMDATAWIDTH
		UIB_NUMPSTATES
		UIB_FREQUENCY_0
		UIB_PLLBYPASS_0
		UIB_DFIFREQRATIO_0
		UIB_DFI1EXISTS
		UIB_TRAIN2D
		UIB_HARDMACROVER
		UIB_READDBIENABLE_0
		UIB_DFIMODE

- st,phy-advanced: advanced entry values for the PHYINIT driver
	43 values are requested in this order
		UIA_LP4RXPREAMBLEMODE_0
		UIA_LP4POSTAMBLEEXT_0
		UIA_D4RXPREAMBLELENGTH_0
		UIA_D4TXPREAMBLELENGTH_0
		UIA_EXTCALRESVAL
		UIA_IS2TTIMING_0
		UIA_ODTIMPEDANCE_0
		UIA_TXIMPEDANCE_0
		UIA_ATXIMPEDANCE
		UIA_MEMALERTEN
		UIA_MEMALERTPUIMP
		UIA_MEMALERTVREFLEVEL
		UIA_MEMALERTSYNCBYPASS
		UIA_DISDYNADRTRI_0
		UIA_PHYMSTRTRAININTERVAL_0
		UIA_PHYMSTRMAXREQTOACK_0
		UIA_WDQSEXT
		UIA_CALINTERVAL
		UIA_CALONCE
		UIA_LP4RL_0
		UIA_LP4WL_0
		UIA_LP4WLS_0
		UIA_LP4DBIRD_0
		UIA_LP4DBIWR_0
		UIA_LP4NWR_0
		UIA_LP4LOWPOWERDRV
		UIA_DRAMBYTESWAP
		UIA_RXENBACKOFF
		UIA_TRAINSEQUENCECTRL
		UIA_SNPSUMCTLOPT
		UIA_SNPSUMCTLF0RC5X_0
		UIA_TXSLEWRISEDQ_0
		UIA_TXSLEWFALLDQ_0
		UIA_TXSLEWRISEAC
		UIA_TXSLEWFALLAC
		UIA_DISABLERETRAINING
		UIA_DISABLEPHYUPDATE
		UIA_ENABLEHIGHCLKSKEWFIX
		UIA_DISABLEUNUSEDADDRLNS
		UIA_PHYINITSEQUENCENUM
		UIA_ENABLEDFICSPOLARITYFIX
		UIA_PHYVREF
		UIA_SEQUENCECTRL_0

- st,phy-mr	: mode register entry values for the PHYINIT driver
	12 values are requested in this order
		UIM_MR0_0
		UIM_MR1_0
		UIM_MR2_0
		UIM_MR3_0
		UIM_MR4_0
		UIM_MR5_0
		UIM_MR6_0
		UIM_MR11_0
		UIM_MR12_0
		UIM_MR13_0
		UIM_MR14_0
		UIM_MR22_0

- st,phy-swizzle: swizzling entry values for the PHYINIT driver
	(i.e. signal / ball multiplexing)
	44 values are requested in this order
		UIS_SWIZZLE_0
		UIS_SWIZZLE_1
		UIS_SWIZZLE_2
		UIS_SWIZZLE_3
		UIS_SWIZZLE_4
		UIS_SWIZZLE_5
		UIS_SWIZZLE_6
		UIS_SWIZZLE_7
		UIS_SWIZZLE_8
		UIS_SWIZZLE_9
		UIS_SWIZZLE_10
		UIS_SWIZZLE_11
		UIS_SWIZZLE_12
		UIS_SWIZZLE_13
		UIS_SWIZZLE_14
		UIS_SWIZZLE_15
		UIS_SWIZZLE_16
		UIS_SWIZZLE_17
		UIS_SWIZZLE_18
		UIS_SWIZZLE_19
		UIS_SWIZZLE_20
		UIS_SWIZZLE_21
		UIS_SWIZZLE_22
		UIS_SWIZZLE_23
		UIS_SWIZZLE_24
		UIS_SWIZZLE_25
		UIS_SWIZZLE_26
		UIS_SWIZZLE_27
		UIS_SWIZZLE_28
		UIS_SWIZZLE_29
		UIS_SWIZZLE_30
		UIS_SWIZZLE_31
		UIS_SWIZZLE_32
		UIS_SWIZZLE_33
		UIS_SWIZZLE_34
		UIS_SWIZZLE_35
		UIS_SWIZZLE_36
		UIS_SWIZZLE_37
		UIS_SWIZZLE_38
		UIS_SWIZZLE_39
		UIS_SWIZZLE_40
		UIS_SWIZZLE_41
		UIS_SWIZZLE_42
		UIS_SWIZZLE_43

Example:

/ {
	soc@0 {
		ddr: ddr@48040000 {
			compatible = "st,stm32mp2-ddr";

			reg = <0x48040000 0x10000>,
			      <0x48c00000 0x400000>;

			st,mem-name = "DDR4 2x16Gbits 2x16bits 1200MHz";
			st,mem-speed = <1200000>;
			st,mem-size = <(0x100000000 >> 32) (0x100000000 & 0xFFFFFFFF)>;

			st,ctl-reg = <
				0x01040010
				0x00000030
				0x00000000
				0x00000000
				0x00000000
				0x00000000
				0x00000000
				0x00000000
				0x00130001
				0x00000002
				0x00210010
				0x00000000
				0x00000000
				0x00000000
				0x00001000
				0xC0020002
				0x00010002
				0x00000D00
				0x09400103
				0x00180000
				0x00100004
				0x00080460
				0x00000C0F
				0x00000000
				0x0000066F
				0x01000040
				0x2000493E
				0x00000000
				0x038F8209
				0x00080303
				0x07004111
				0x00000000
				0xC0300018
				0x005700B4
				0x80000000
				0x00000041
				0x00000F09
				0x00000000
				0x00000001
				0x80000000
				0x00000000
				0x00000000
				0x00000000
				0x00000000
				0x00000000
				0x00000000
			>;

			st,ctl-timing = <
				0x0092014A
				0x008C0000
				0x11152815
				0x0004051E
				0x0609060D
				0x0050400C
				0x0904050A
				0x06060403
				0x02020005
				0x00000202
				0x0606100B
				0x0002040A
				0x001C180A
				0x4408021C
				0x0C020010
				0x1C200004
				0x000000A0
				0x00000000
				0x06000618
				0x00000001
			>;

			st,ctl-map = <
				0x0000001F
				0x003F0909
				0x00000000
				0x00000000
				0x00001F1F
				0x070F0707
				0x07070707
				0x00000F07
				0x00003F08
				0x07070707
				0x07070707
				0x00000007
			>;

			st,ctl-perf = <
				0x80001B0C
				0x00000000
				0x04000200
				0x08000020
				0x08000400
				0x00704100
				0x00004100
				0x00000000
				0x0021000C
				0x01000080
				0x01100C07
				0x04000200
				0x00704100
				0x00004100
				0x00000000
				0x00100007
				0x01000080
				0x01100C07
				0x04000200
			>;

			st,phy-basic = <
				0x00000000
				0x00000004
				0x00000000
				0x00000004
				0x00000004
				0x00000000
				0x00000008
				0x00000001
				0x00000001
				0x00000010
				0x00000001
				0x000004B0
				0x00000000
				0x00000001
				0x00000001
				0x00000000
				0x00000003
				0x00000000
				0x00000000
			>;

			st,phy-advanced = <
				0x00000000
				0x00000000
				0x00000000
				0x00000000
				0x00000000
				0x00000000
				0x00000035
				0x00000028
				0x00000028
				0x00000000
				0x00000000
				0x00000000
				0x00000000
				0x00000001
				0x00000000
				0x00000000
				0x00000000
				0x00000009
				0x00000000
				0x00000000
				0x00000000
				0x00000000
				0x00000000
				0x00000000
				0x00000000
				0x00000000
				0x00000000
				0x00000000
				0x00000000
				0x00000000
				0x00000000
				0x0000000F
				0x0000000F
				0x0000000F
				0x0000000F
				0x00000001
				0x00000000
				0x00000000
				0x00000001
				0x00000000
				0x00000000
				0x0000005E
				0x0000031F
			>;

			st,phy-mr = <
				0x00000940
				0x00000103
				0x00000018
				0x00000000
				0x00000008
				0x00000460
				0x00000C0F
				0x00000000
				0x00000000
				0x00000000
				0x00000000
				0x00000000
			>;

			st,phy-swizzle = <
				0x0000000C
				0x00000005
				0x00000013
				0x0000001A
				0x00000009
				0x00000003
				0x00000001
				0x00000019
				0x00000007
				0x00000004
				0x0000000A
				0x0000000D
				0x00000014
				0x00000000
				0x00000000
				0x00000000
				0x00000000
				0x00000000
				0x00000006
				0x0000000B
				0x00000000
				0x00000000
				0x00000000
				0x00000008
				0x00000002
				0x00000018
				0x1A13050C
				0x19010309
				0x0D0A0407
				0x00000014
				0x000B0600
				0x02080000
				0x00000018
				0x00000000
				0x00000000
				0x00000000
				0x00000000
				0x00000000
				0x00000000
				0x00000000
				0x00000000
				0x00000000
				0x00000000
				0x00000000
			>;

			status = "okay";
		};
	};
};
```

## docs/devicetree/bindings/mmc/st,stm32-sdmmc2.txt
```
* STMicroelectronics STM32 SDMMC2 controller

The highspeed MMC host controller on STM32 soc family
provides an interface for MMC, SD and SDIO types of memory cards.

This file documents differences between the core properties described
by mmci.txt and the properties used by the sdmmc2 driver.

Required properties:
 - compatible: should be one of:
   "st,stm32-sdmmc2"

Example:
	sdmmc1: sdmmc@0x58005000 {
		compatible = "st,stm32-sdmmc2";
		reg = <0x58005000 0x1000>;
		clocks = <&rcc SDMMC1_K>;
		resets = <&rcc SDMMC1_R>;
		cap-sd-highspeed;
		cap-mmc-highspeed;
		status = "disabled";
	};
```

## docs/devicetree/bindings/power/st,stm32mp21-pwr.txt
```
STMicroelectronics STM32MP21 Power Management Controller
=======================================================

The PWR IP is responsible for handling the power related resources such as
clocks, power supplies and resets.
When optional properties are absent, default values are used and those
properties should be present only to overidde those values.

Required properties:
- compatible should be: "st,stm32mp21-pwr"
- reg: should be register base and length as documented in the
  datasheet
- vddio(|[1-3]): sub-node for each VDD I/O description with valid name =
  "vddio", "vddio1", "vddio2" and "vddio3".
  The definition for each of these nodes is defined using the standard binding
  for regulators at Documentation/devicetree/bindings/regulator/regulator.txt
  or regulator.yaml, like "regulator-name", "regulator-min-microvolt",
  "regulator-max-microvolt", "regulator-always-on"
  - vdd-supply: Input supply phandle (VDD) for I/Os for "vddio" node
  - vddio[1-3]-supply: Input supply phandle (VDIO1-4) for respectively
                       "vddio1", "vddio2" and "vddio3" nodes,
                       the I/Os independent from any other supply.

Optional Properties:
- st,popl-d1-ms : PWR_CPU_ON pulse low configuration (PWR_D1CR)
- st,podh-d2-ms : PWR_ON delay high configuration (PWR_D2CR)
- st,popl-d2-ms : PWR_ON pulse low configuration (PWR_D2CR)
- st,lpcfg-d2 : PWR_ON pin configuration (PWR_D2CR)
- st,lplvdly-d2 : LPLV delay value (PWR_D2CR), 3bits and with 6xLSI cycles unit
                  (0:187 μs... 111:1.5 ms)
- st,lpstop1dly-us: PWR_LP delay value in us for LP-Stop1 mode
                    (RCC_PWRLPDLYCR.PWRLP_DLY)

Example:

pwr: pwr@44210000 {
	compatible = "st,stm32mp21-pwr";
	reg = <0x44210000 0x400>;

	vddio1: vddio1 {
		regulator-name = "vddio1";
		vddio1-supply = <&vddio_sdcard>;
	};
	vddio2: vddio2 {
		regulator-name = "vddio2";
		vddio2-supply = <&v1v8>;
	};
	vddio3: vddio3 {
		regulator-name = "vddio3";
		vddio3-supply = <&vddio_pmic>;
	};
	vddio: vddio {
		regulator-name = "vddio";
		vdd-supply = <&vddio_pmic>;
	};
};
```
