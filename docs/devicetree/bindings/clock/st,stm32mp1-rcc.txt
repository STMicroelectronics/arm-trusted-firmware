## docs/devicetree/bindings/power/st,stpmic1.txt
```
* STMicroelectronics STPMIC1 Power Management IC

Required parent device properties:
- compatible:			"st,stpmic1"
- reg:				The I2C slave address for the STPMIC1 chip.
- interrupts:			The interrupt lines the device is connected to.
				The second interrupt is used for wake-up.
- #interrupt-cells:		Should be 2.
- interrupt-controller: 	Describes the STPMIC1 as an interrupt
  controller (has its own domain). Interrupt number are the following:
	/* Interrupt Register 1 (0x50 for latch) */
	IT_SWOUT_R=0
	IT_SWOUT_F=1
	IT_VBUS_OTG_R=2
	IT_VBUS_OTG_F=3
	IT_WAKEUP_R=4
	IT_WAKEUP_F=5
	IT_PONKEY_R=6
	IT_PONKEY_F=7
	/* Interrupt Register 2 (0x51 for latch) */
	IT_OVP_BOOST=8
	IT_OCP_BOOST=9
	IT_OCP_SWOUT=10
	IT_OCP_OTG=11
	IT_CURLIM_BUCK4=12
	IT_CURLIM_BUCK3=13
	IT_CURLIM_BUCK2=14
	IT_CURLIM_BUCK1=15
	/* Interrupt Register 3 (0x52 for latch) */
	IT_SHORT_SWOUT=16
	IT_SHORT_SWOTG=17
	IT_CURLIM_LDO6=18
	IT_CURLIM_LDO5=19
	IT_CURLIM_LDO4=20
	IT_CURLIM_LDO3=21
	IT_CURLIM_LDO2=22
	IT_CURLIM_LDO1=23
	/* Interrupt Register 3 (0x52 for latch) */
	IT_SWIN_R=24
	IT_SWIN_F=25
	IT_RESERVED_1=26
	IT_RESERVED_2=27
	IT_VINLOW_R=28
	IT_VINLOW_F=29
	IT_TWARN_R=30
	IT_TWARN_F=31

STPMIC1 consists in a varied group of sub-devices.
Each sub-device binding is be described in own documentation file.

Device			 Description
------			------------
st,stpmic1-onkey	: Power on key, see ../input/st,stpmic1-onkey.txt
st,stpmic1-regulators	: Regulators, see ../regulator/st,stpmic1-regulator.txt
st,stpmic1-wdt		: Watchdog, see ../watchdog/st,stpmic1-wdt.txt

Example:

pmic: pmic@33 {
	compatible = "st,stpmic1";
	reg = <0x33>;
	interrupt-parent = <&gpioa>;
	interrupts = <0 2>;
	interrupt-controller;
	#interrupt-cells = <2>;

	onkey {
		compatible = "st,stpmic1-onkey";
		interrupts = <IT_PONKEY_F 0>,<IT_PONKEY_R 1>;
		interrupt-names = "onkey-falling", "onkey-rising";
		power-off-time-sec = <10>;
	};

	watchdog {
		compatible = "st,stpmic1-wdt";
	};

	regulators {
		compatible = "st,stpmic1-regulators";

		vdd_core: buck1 {
			regulator-name = "vdd_core";
			regulator-boot-on;
			regulator-min-microvolt = <700000>;
			regulator-max-microvolt = <1200000>;
		};
		vdd: buck3 {
			regulator-name = "vdd";
			regulator-min-microvolt = <3300000>;
			regulator-max-microvolt = <3300000>;
			regulator-boot-on;
			regulator-pull-down;
		};
	};
```

## docs/devicetree/bindings/rng/st,stm32-rng.txt
```
STMicroelectronics STM32 HW RNG
===============================

The STM32 hardware random number generator is a simple fixed purpose IP and
is fully separated from other crypto functions.

Required properties:

- compatible : Should be "st,stm32-rng"
- reg : Should be register base and length as documented in the datasheet
- clocks : The clock needed to enable the RNG

Optional properties:
- resets : The reset to properly start RNG
- clock-error-detect : Enable the clock detection management
- st,rng-cfg: The configuration bitfields to initialize the RNG. They must
  be listed in the numerical order. If not specified, the default hard-coded
  values will be used. Number of values depends on the presence of
  st,rng-nist-custom property.
- st,rng-cfg-nist-custom: Enable custom values for NIST compliant RNG.
- st,rng-htcfg: The values to configure health tests. If not specified, the
  default hard-coded values will be used.

Example:

	rng: rng@50060800 {
		compatible = "st,stm32-rng";
		reg = <0x50060800 0x400>;
		clocks = <&rcc 0 38>;
	};
```

## docs/devicetree/bindings/serial/st,stm32-usart.txt
```
* STMicroelectronics STM32 USART

Required properties:
- compatible: can be either:
  - "st,stm32-uart",
  - "st,stm32f7-uart",
  - "st,stm32h7-uart".
  depending is compatible with stm32(f4), stm32f7 or stm32h7.
- reg: The address and length of the peripheral registers space
- interrupts:
  - The interrupt line for the USART instance,
  - An optional wake-up interrupt.
- interrupt-names: Contains "event" for the USART interrupt line.
- clocks: The input clock of the USART instance

Optional properties:
- resets: Must contain the phandle to the reset controller.
- pinctrl-names: Set to "default". An additional "sleep" state can be defined
  to set pins in sleep state when in low power. In case the device is used as
  a wakeup source, "idle" state is defined in order to keep RX pin active.
  For a console device, an optional state "no_console_suspend" can be defined
  to enable console messages during suspend. Typically, "no_console_suspend" and
  "default" states can refer to the same pin configuration.
- pinctrl-n: Phandle(s) pointing to pin configuration nodes.
  For Pinctrl properties see ../pinctrl/pinctrl-bindings.txt
- st,hw-flow-ctrl: bool flag to enable hardware flow control.
- rs485-rts-delay, rs485-rx-during-tx, rs485-rts-active-low,
  linux,rs485-enabled-at-boot-time: see rs485.txt.
- dmas: phandle(s) to DMA controller node(s). Refer to stm32-dma.txt
- dma-names: "rx" and/or "tx"
- wakeup-source: bool flag to indicate this device has wakeup capabilities
- interrupt-names : Should contain "wakeup" if optional wake-up interrupt is
  used.

Note for dma using:
- "tx" dma can be used without any constraint since it uses single
dma transfers.
- "rx" dma using requires some attention:
   1) if you cannot anticipate the length of your received packets
   and if your usart device embeds an internal fifo, then DON'T use
   dma mode.
   2) if you enable dma mode WITHOUT mdma intermediate copy (cf.
   stm32-dma.txt), then the availability of the received data will
   depend on the dma driver policy and it may be delayed until dma
   internal fifo is full. The usart driver will see this checking
   the dma residue when rx interrupt (RXNE or RTO) occurs.
   3) if you enable dma mode WITH mdma intermediate copy (cf.
   stm32-dma.txt) then the usart driver will never see the dma
   residue becoming smaller than RX_BUF_P but it will get its
   rx dma complete callback called when the cyclic transfer period
   (RX_BUF_P) is reached.
The three possibilities above are ordered from the most cpu time
consuming one to the least one. The counterpart of this optimisation
is the reception granularity achievable by the usart driver, from
one byte up to RX_BUF_P.

Examples:
usart4: serial@40004c00 {
	compatible = "st,stm32-uart";
	reg = <0x40004c00 0x400>;
	interrupts = <52>;
	clocks = <&clk_pclk1>;
	pinctrl-names = "default", "sleep", "idle", "no_console_suspend";
	pinctrl-0 = <&pinctrl_usart4>;
	pinctrl-1 = <&pinctrl_usart4_sleep>;
	pinctrl-2 = <&pinctrl_usart4_idle>;
	pinctrl-3 = <&pinctrl_usart4>;
};

usart2: serial@40004400 {
	compatible = "st,stm32-uart";
	reg = <0x40004400 0x400>;
	interrupts = <38>;
	clocks = <&clk_pclk1>;
	st,hw-flow-ctrl;
	pinctrl-names = "default";
	pinctrl-0 = <&pinctrl_usart2 &pinctrl_usart2_rtscts>;
};

usart1: serial@40011000 {
	compatible = "st,stm32-uart";
	reg = <0x40011000 0x400>;
	interrupts = <37>;
	clocks = <&rcc 0 164>;
	dmas = <&dma2 2 4 0x414 0x0>,
	       <&dma2 7 4 0x414 0x0>;
	dma-names = "rx", "tx";
};
```

## docs/devicetree/bindings/soc/st,stm32-etzpc.txt
```
STM32 ETZPC
---------------------------------

Required properties:
- compatible: should be "st,stm32-etzpc"
- reg: physical base address and length of the registers set for the device
- clocks: reference to the clock entry

Optional property:
- st,decprot: Configure option to properly set firewall for IPs.

Examples:
etzpc: etzpc@5C007000 {
			compatible = "st,stm32-etzpc";
			reg = <0x5C007000 0x400>;
			clocks = <&rcc TZPC>;
		};

Firewall specifications
=======================

DECPROT macro must be used to properly configure IP firewalling. It must
specify ID, domain and locking register status.

The macro is defined in the binding header file [1].

Example:
	... {
	st,decprot = <
	DECPROT(STM32MP1_ETZPC_I2C4_ID, DECPROT_NS_RW, DECPROT_UNLOCK)
	DECPROT(STM32MP1_ETZPC_RNG1_ID, DECPROT_NS_RW, DECPROT_UNLOCK)
	DECPROT(STM32MP1_ETZPC_HASH1_ID, DECPROT_NS_RW,	DECPROT_UNLOCK)
	DECPROT(STM32MP1_ETZPC_CRYP1_ID, DECPROT_NS_RW,	DECPROT_UNLOCK)
	DECPROT(STM32MP1_ETZPC_GPIOZ_ID, DECPROT_NS_RW,	DECPROT_UNLOCK)>;
	};

Specify Peripheral IDs
=======================

Each peripheral is identified with a specific ID. Each platform defines the
identifiers relevant to that platform. Peripheral IDs are defined in [1].

Specify domain
==============
Firewall controls peripherals in specific domains:

DECPROT_S_RW		0x0  -> Read/write Secure
DECPROT_NS_R_S_W	0x1  -> Non secure read / Read/write Secure
DECPROT_MCU_ISOLATION	0x2  -> MCU access only
DECPROT_NS_RW		0x3  -> Non secure read/write


[1] include/dt-bindings/soc/st,stm32-etzpc.h
```

## docs/devicetree/bindings/soc/st,stm32-romem.txt
```
STMicroelectronics STM32 Factory-programmed data device tree bindings

This represents STM32 Factory-programmed read only non-volatile area: locked
flash, OTP, read-only HW regs... This contains various information such as:
analog calibration data for temperature sensor (e.g. TS_CAL1, TS_CAL2),
internal vref (VREFIN_CAL), unique device ID...

Required properties:
- compatible:		Should be one of:
			"st,stm32f4-otp"
			"st,stm32mp13-bsec"
			"st,stm32mp15-bsec"
- reg:			Offset and length of factory-programmed area.
- #address-cells:	Should be '<1>'.
- #size-cells:		Should be '<1>'.

Optional Data cells:
- Must be child nodes as described in nvmem.txt.

Optional-properties:
- "st,non-secure-otp" specifies that the OTP can be accessed by non-secure
  world through secure world services. Only useful for upper OTPs. This
  property mandates 32-bit granularity of the related nvmem area, that is
  offset and length are both multiple of 4.

Example on stm32f4:
	romem: efuse@1fff7800 {
		compatible = "st,stm32f4-otp";
		reg = <0x1fff7800 0x400>;
		#address-cells = <1>;
		#size-cells = <1>;

		/* Data cells: ts_cal1 at 0x1fff7a2c */
		ts_cal1: calib@22c {
			reg = <0x22c 0x2>;
		};
		...
	};

Example on stm32mp15:
	bsec: efuse@5c005000 {
		compatible = "st,stm32mp15-bsec";
		reg = <0x5c005000 0x400>;
		#address-cells = <1>;
		#size-cells = <1>;

		mac_addr: mac_addr@e4 {
			reg = <0xe4 0x8>;
			st,non-secure-otp;
		};
		...
	};
```

## docs/devicetree/bindings/soc/st,stm32-stgen.txt
```
STMicroelectronics STM32 STGEN
===============================

The STM32 System Generic Counter generate a time count value. This
is a 64 bits wide counter.

Required properties:

- compatible : Should be "st,stm32-stgen"
- reg : Should be register base and length as documented in the datasheet

Example:

	stgen: stgen@5C008000 {
		compatible = "st,stm32-stgen";
		reg = <0x5C008000 0x1000>;
		status = "okay";
	};
```

## docs/devicetree/bindings/soc/st,stm32-tamp.txt
```
STM32 TAMPER
---------------------------------

Required properties:
- compatible: should be "st,stm32-tamp"
- reg: physical base address and length of the registers set for the device
- clocks: reference to the clock entry

Optional property:
- st,out3-pc13: Configure option register to map OUT3 on PC13
- wakeup-source : Configure tamp as wakeup-src

Examples:
tamp: tamp@5C00A000 {
	compatible = "st,stm32-tamp";
	reg = <0x5C00A000 0x100>;
	clocks = <&rcc_clk RTCAPB>;
	st,out3-pc13;
	wakeup-source;
};
```

## docs/devicetree/bindings/watchdog/st,stm32-iwdg.txt
```
STM32 Independent WatchDoG (IWDG)
---------------------------------

Required properties:
- compatible: should be "st,stm32mp1-iwdg".
- reg: physical base address and length of the registers set for the device.
- clocks: reference to the clock entry lsi. Additional pclk clock entry.
  is required only for st,stm32mp1-iwdg.
- clock-names: name of the clocks used.
  "pclk", "lsi" for st,stm32mp1-iwdg.

Optional properties:
- timeout-sec: Watchdog timeout value in seconds.
- secure-timeout-sec: Watchdog early timeout management in seconds.
- stm32,enable-on-stop: Keep watchdog enable during stop.
- stm32,enable-on-standby: Keep watchdog enable durung standby.

Examples:

iwdg2: iwdg@5a002000 {
	compatible = "st,stm32mp1-iwdg";
	reg = <0x5a002000 0x400>;
	clocks = <&rcc IWDG2>, <&clk_lsi>;
	clock-names = "pclk", "lsi";
	instance = <2>;
	timeout-sec = <30>;
};
```
