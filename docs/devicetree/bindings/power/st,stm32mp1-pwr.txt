## docs/devicetree/bindings/power/st,stm32mp1-pwr.txt
```
STMicroelectronics STM32MP1 Power Management Controller
=======================================================

The PWR IP is responsible for handling the power related resources such as
clocks, power supplies and resets. It provides 6 wake-up pins that are handled
by an interrupt-controller. Wake-up pin can be used to wake-up from STANDBY SoC
state.

Required properties:
- compatible should be: "st,stm32mp1-pwr", "st,stm32-pwr"
- reg: should be register base and length as documented in the
  datasheet

Example:

pwr: pwr@50001000 {
	compatible = "st,stm32mp1-pwr", "st,stm32-pwr", "syscon", "simple-mfd";
	reg = <0x50001000 0x400>;
};
```
